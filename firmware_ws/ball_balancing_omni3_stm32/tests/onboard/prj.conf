## CMakeLists.txt
```
cmake_minimum_required(VERSION 3.20.0)

# 実機ソフトと同じ devicetree 構成（bb,pins / qdec / imu / timers6）を適用する。
set(DTC_OVERLAY_FILE
    "${CMAKE_CURRENT_SOURCE_DIR}/../../boards/nucleo_g474re.overlay")

# 実機ソフト側の dts/bindings（bb,pins 等）を参照する。
list(APPEND DTS_ROOT ${CMAKE_CURRENT_SOURCE_DIR}/../..)

# hal_stm32 モジュール（west ワークスペース外のため明示）。
if(NOT DEFINED ENV{ZEPHYR_WS_DIR})
  set(ZEPHYR_WS_DIR "C:/zephyr_ws")
else()
  set(ZEPHYR_WS_DIR "$ENV{ZEPHYR_WS_DIR}")
endif()
list(APPEND ZEPHYR_MODULES
  ${ZEPHYR_WS_DIR}/modules/hal/stm32
  ${ZEPHYR_WS_DIR}/modules/hal/cmsis_6
  ${ZEPHYR_WS_DIR}/modules/hal/st
)

find_package(Zephyr REQUIRED HINTS $ENV{ZEPHYR_BASE})
project(bb_onboard_tests LANGUAGES C CXX)

set(APP_SRC ${CMAKE_CURRENT_SOURCE_DIR}/../../src)

target_include_directories(app PRIVATE
  ${APP_SRC}
  ${CMAKE_CURRENT_SOURCE_DIR}/src
  ${CMAKE_CURRENT_SOURCE_DIR}/../../third_party/etl/include
)

# 制限付きC++: 例外・RTTI・動的確保は使用しない。
target_compile_options(app PRIVATE
  $<$<COMPILE_LANGUAGE:CXX>:-fno-exceptions -fno-rtti -fno-threadsafe-statics -Wall -Wextra -DETL_NO_STL>
)

target_sources(app PRIVATE
  src/main.cpp

  ${APP_SRC}/peripheral/gpio_pin/gpio_pin.cpp
  ${APP_SRC}/peripheral/pwm_output/pwm_output.cpp
  ${APP_SRC}/peripheral/encoder_counter/encoder_counter.cpp
  ${APP_SRC}/peripheral/timebase/timebase.cpp
  ${APP_SRC}/peripheral/control_tick/control_tick.cpp
  ${APP_SRC}/peripheral/debug_uart/debug_uart.cpp
  ${APP_SRC}/peripheral/link_uart/link_uart.cpp

  ${APP_SRC}/common/link_protocol/link_protocol.cpp
  ${APP_SRC}/common/param_store/param_store.cpp

  ${APP_SRC}/device/lsm6dso/lsm6dso.cpp
  ${APP_SRC}/device/wheel_encoder/wheel_encoder.cpp
  ${APP_SRC}/device/mdd3a_motor/mdd3a_motor.cpp
  ${APP_SRC}/device/status_led/status_led.cpp
  ${APP_SRC}/device/estop_input/estop_input.cpp

  ${APP_SRC}/feature/state_estimator/state_estimator.cpp
  ${APP_SRC}/feature/wheel_speed_meter/wheel_speed_meter.cpp

  src/test_application/test_application.cpp
  src/test_runner/test_runner.cpp
  src/estop_test/estop_test.cpp
  src/tick_timing_test/tick_timing_test.cpp
  src/imu_attitude_test/imu_attitude_test.cpp
  src/encoder_test/encoder_test.cpp
  src/omni_drive_test/omni_drive_test.cpp
  src/motor_deadzone_test/motor_deadzone_test.cpp
  src/uart_echo_test/uart_echo_test.cpp
  src/link_test/link_test.cpp
)
```

## prj.conf
```kconfig
# Zephyr 4.3.0 / nucleo_g474re — 検証用オンボードテスト
CONFIG_GPIO=y
CONFIG_DYNAMIC_INTERRUPTS=y
CONFIG_PWM=y
CONFIG_I2C=y
CONFIG_SENSOR=y
CONFIG_LSM6DSO=y

CONFIG_SERIAL=y
CONFIG_UART_INTERRUPT_DRIVEN=y
CONFIG_CONSOLE=y
CONFIG_PRINTK=y
CONFIG_LOG=y
CONFIG_SHELL=y
CONFIG_SHELL_BACKEND_SERIAL=y
# printk が LOG 経由でシェルのログバックエンドに流れ、メッセージ毎に
# 「行消去＋プロンプト再描画」が挟まるのを防ぐ（printk は UART コンソールへ直接出力）。
CONFIG_LOG_PRINTK=n
# printk(uart_poll_out)とシェル割込TXの競合を避けるためシェルTXもpoll_outに統一
# （RXは割込駆動のまま）。
CONFIG_SHELL_BACKEND_SERIAL_FORCE_TX_BLOCKING_MODE=y

# 制限付きC++（例外・RTTI・動的確保なし）
CONFIG_CPP=y
CONFIG_STD_CPP23=y
CONFIG_STATIC_INIT_GNU=n

# FPU 利用（制御スレッドで浮動小数点を使用）
CONFIG_FPU=y
CONFIG_FPU_SHARING=y

# ヒープは使用しない
CONFIG_HEAP_MEM_POOL_SIZE=0

CONFIG_MAIN_STACK_SIZE=8192
CONFIG_SYSTEM_WORKQUEUE_STACK_SIZE=2048

# ログ
CONFIG_LOG_DEFAULT_LEVEL=3
CONFIG_LOG_MODE_IMMEDIATE=y
```

## src/main.cpp
```c
#include "test_application/test_application.hpp"

// オンボード検証用ファームウェア。実機ソフトとは別ビルドで、
// shell コマンド `test` から各検証テストを実行する。
// ハードウェア初期化は devicetree + Zephyr ドライバの SYS 初期化で
// 完了している。ここでは各 static class を初期化してテスト実行
// ループ（control_tick 1 kHz 駆動）を開始するだけ。

int main() {
  bb::test_application::init();
  bb::test_application::run();
}
```
