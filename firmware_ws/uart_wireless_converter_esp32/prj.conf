## CMakeLists.txt
```
cmake_minimum_required(VERSION 3.20.0)

# モジュール（hal_espressif, mbedtls 等）は west マニフェストから自動検出する。
# 無線（BLE/Wi-Fi）利用には hal_espressif と `west blobs fetch hal_espressif`
# で取得するバイナリ blob が必要。
find_package(Zephyr REQUIRED HINTS $ENV{ZEPHYR_BASE})
project(uart_wireless_converter_esp32 LANGUAGES C CXX)

target_include_directories(app PRIVATE
  ${CMAKE_CURRENT_SOURCE_DIR}/src
  ${CMAKE_CURRENT_SOURCE_DIR}/third_party/etl/include
)

# 制限付きC++: 例外・RTTI・動的確保は使用しない。
# ただし ESP32 無線スタック（hal_espressif blob）の内部確保のため
# カーネルヒープ自体は有効化する（NFR-04 参照）。
target_compile_options(app PRIVATE
  $<$<COMPILE_LANGUAGE:CXX>:-fno-exceptions -fno-rtti -fno-threadsafe-statics -Wall -Wextra -DETL_NO_STL>
)

target_sources(app PRIVATE
  src/main.cpp

  src/peripheral/host_uart/host_uart.cpp
  src/peripheral/debug_console/debug_console.cpp
  src/peripheral/status_led/status_led.cpp

  src/feature/uart_bridge/uart_bridge.cpp
  src/feature/link_monitor/link_monitor.cpp

  src/manager/converter_application/converter_application.cpp
)

# トランスポートは Kconfig (UWC_TRANSPORT_*) で選択する（FR-04, NFR-03）。
# 同一クラス名 `link` の実装をビルド時に切替える。
if(CONFIG_UWC_TRANSPORT_WIFI)
  target_sources(app PRIVATE src/device/link/link_wifi.cpp)
else()
  target_sources(app PRIVATE src/device/link/link_ble.cpp)
endif()
```

## Kconfig
```
# UART-wireless converter アプリケーション Kconfig

mainmenu "uart_wireless_converter_esp32"

source "Kconfig.zephyr"

choice UWC_TRANSPORT
	prompt "Wireless transport"
	default UWC_TRANSPORT_BLE
	help
	  無線トランスポートの実装選択。device/link の link クラスを
	  ビルド時に切替える。UART 側インターフェースは不変。

config UWC_TRANSPORT_BLE
	bool "BLE (NUS-equivalent transparent UART)"
	select BT
	select BT_PERIPHERAL
	help
	  BLE ペリフェラルとして NUS 相当の GATT サービスを提供し、
	  UART バイトストリームを透過する。

config UWC_TRANSPORT_WIFI
	bool "Wi-Fi SoftAP + TCP (future)"
	help
	  Wi-Fi SoftAP 上の TCP ソケットで UART を透過する将来実装。

endchoice
```

## prj.conf
```kconfig
# Zephyr 4.3.0 / xiao_esp32c6/esp32c6/hpcore
CONFIG_GPIO=y
CONFIG_DYNAMIC_INTERRUPTS=y

# host 側 UART（uart0、G474 への物理リンク）
CONFIG_SERIAL=y
CONFIG_UART_INTERRUPT_DRIVEN=y

# USB-Serial-JTAG 上の console/shell（usb_serial、espressif,esp32-usb-serial）
CONFIG_CONSOLE=y
CONFIG_PRINTK=y
CONFIG_LOG=y
CONFIG_SHELL=y
CONFIG_SHELL_BACKEND_SERIAL=y
CONFIG_UART_CONSOLE=y

# BLE ペリフェラル（UWC_TRANSPORT_BLE 時）
CONFIG_BT=y
CONFIG_BT_PERIPHERAL=y
CONFIG_BT_DEVICE_NAME="uwc-esp32c6"
CONFIG_BT_DEVICE_APPEARANCE=0
CONFIG_BT_MAX_CONN=1
CONFIG_BT_GATT_CLIENT=y
CONFIG_BT_USER_PHY_UPDATE=y
CONFIG_BT_DATA_LEN_UPDATE=y
CONFIG_BT_USER_DATA_LEN_UPDATE=y

# ATT MTU 拡大（NFR-01: MTU 247 目標）。BT_SMP 無効時の既定値では
# L2CAP TX MTU=23・ACL RX=27B（RX MTU=23）となり Exchange MTU が
# 実効しないため、L2CAP/ACL バッファを 247 B ATT PDU に合わせて拡大する。
CONFIG_BT_L2CAP_TX_MTU=247
CONFIG_BT_BUF_ACL_RX_SIZE=251
CONFIG_BT_BUF_ACL_TX_SIZE=251

# 制限付きC++（例外・RTTI・動的確保なし）
CONFIG_CPP=y
CONFIG_STD_CPP23=y
CONFIG_STATIC_INIT_GNU=n

# カーネルヒープは ESP 無線スタック内部確保のため有効化する。
# アプリケーション側コードは動的確保を使わない（NFR-04）。
CONFIG_HEAP_MEM_POOL_SIZE=54096

CONFIG_MAIN_STACK_SIZE=4096
CONFIG_SYSTEM_WORKQUEUE_STACK_SIZE=2048

# ログ
CONFIG_LOG_DEFAULT_LEVEL=3
CONFIG_LOG_MODE_IMMEDIATE=y
```

## boards/xiao_esp32c6_esp32c6_hpcore.overlay
```dts
/*
 * UART-wireless converter on XIAO ESP32-C6 (HP core)
 * ピン割当の正本は spec/requirements/hardware_config.md
 */

/ {
	aliases {
		/* G474 (USART1: PC4/PC5) へ接続する物理 UART。
		 * XIAO コネクタ D6=GPIO16(TX) / D7=GPIO17(RX) */
		host-uart = &uart0;
	};
};

/* uart0: G474 USART1 とのバイトストリームリンク */
&uart0 {
	current-speed = <115200>;
};
```

## src/main.cpp
```c
#include <zephyr/kernel.h>

#include "manager/converter_application/converter_application.hpp"

int main() {
  const uwc::converter_application::config cfg{};
  if (!uwc::converter_application::init(cfg)) {
    return -1;
  }
  uwc::converter_application::run();  // 戻らない
}
```
